## build/Kconfig/soc/Kconfig.defconfig
```kconfig
# Load Zephyr SoC Kconfig defconfig.
osource "C:/Users/Jin/Documents/GitHub/ese518_Cellular_test/zephyr/soc/xlnx/zynqmp/Kconfig.defconfig"
osource "C:/Users/Jin/Documents/GitHub/ese518_Cellular_test/zephyr/soc/xlnx/zynq7000/Kconfig.defconfig"
osource "C:/Users/Jin/Documents/GitHub/ese518_Cellular_test/zephyr/soc/xen/Kconfig.defconfig"
osource "C:/Users/Jin/Documents/GitHub/ese518_Cellular_test/zephyr/soc/ti/simplelink/Kconfig.defconfig"
osource "C:/Users/Jin/Documents/GitHub/ese518_Cellular_test/zephyr/soc/ti/lm3s6965/Kconfig.defconfig"
osource "C:/Users/Jin/Documents/GitHub/ese518_Cellular_test/zephyr/soc/ti/k3/Kconfig.defconfig"
osource "C:/Users/Jin/Documents/GitHub/ese518_Cellular_test/zephyr/soc/telink/tlsr/Kconfig.defconfig"
osource "C:/Users/Jin/Documents/GitHub/ese518_Cellular_test/zephyr/soc/starfive/jh71xx/Kconfig.defconfig"
osource "C:/Users/Jin/Documents/GitHub/ese518_Cellular_test/zephyr/soc/st/stm32/Kconfig.defconfig"
osource "C:/Users/Jin/Documents/GitHub/ese518_Cellular_test/zephyr/soc/snps/qemu_arc/Kconfig.defconfig"
osource "C:/Users/Jin/Documents/GitHub/ese518_Cellular_test/zephyr/soc/snps/nsim/Kconfig.defconfig"
osource "C:/Users/Jin/Documents/GitHub/ese518_Cellular_test/zephyr/soc/snps/hsdk4xd/Kconfig.defconfig"
osource "C:/Users/Jin/Documents/GitHub/ese518_Cellular_test/zephyr/soc/snps/hsdk/Kconfig.defconfig"
osource "C:/Users/Jin/Documents/GitHub/ese518_Cellular_test/zephyr/soc/snps/emsk/Kconfig.defconfig"
osource "C:/Users/Jin/Documents/GitHub/ese518_Cellular_test/zephyr/soc/snps/emsdp/Kconfig.defconfig"
osource "C:/Users/Jin/Documents/GitHub/ese518_Cellular_test/zephyr/soc/snps/arc_iot/Kconfig.defconfig"
osource "C:/Users/Jin/Documents/GitHub/ese518_Cellular_test/zephyr/soc/silabs/Kconfig.defconfig"
osource "C:/Users/Jin/Documents/GitHub/ese518_Cellular_test/zephyr/soc/sifive/sifive_freedom/Kconfig.defconfig"
osource "C:/Users/Jin/Documents/GitHub/ese518_Cellular_test/zephyr/soc/rockchip/Kconfig.defconfig"
osource "C:/Users/Jin/Documents/GitHub/ese518_Cellular_test/zephyr/soc/renode/riscv_virtual/Kconfig.defconfig"
osource "C:/Users/Jin/Documents/GitHub/ese518_Cellular_test/zephyr/soc/renesas/smartbond/Kconfig.defconfig"
osource "C:/Users/Jin/Documents/GitHub/ese518_Cellular_test/zephyr/soc/renesas/rzt2m/Kconfig.defconfig"
osource "C:/Users/Jin/Documents/GitHub/ese518_Cellular_test/zephyr/soc/renesas/rcar/Kconfig.defconfig"
osource "C:/Users/Jin/Documents/GitHub/ese518_Cellular_test/zephyr/soc/renesas/ra/Kconfig.defconfig"
osource "C:/Users/Jin/Documents/GitHub/ese518_Cellular_test/zephyr/soc/raspberrypi/Kconfig.defconfig"
osource "C:/Users/Jin/Documents/GitHub/ese518_Cellular_test/zephyr/soc/quicklogic/eos_s3/Kconfig.defconfig"
osource "C:/Users/Jin/Documents/GitHub/ese518_Cellular_test/zephyr/soc/qemu/virt_riscv/Kconfig.defconfig"
osource "C:/Users/Jin/Documents/GitHub/ese518_Cellular_test/zephyr/soc/qemu/malta/Kconfig.defconfig"
osource "C:/Users/Jin/Documents/GitHub/ese518_Cellular_test/zephyr/soc/openisa/rv32m1/Kconfig.defconfig"
osource "C:/Users/Jin/Documents/GitHub/ese518_Cellular_test/zephyr/soc/nxp/s32/Kconfig.defconfig"
osource "C:/Users/Jin/Documents/GitHub/ese518_Cellular_test/zephyr/soc/nxp/rw/Kconfig.defconfig"
osource "C:/Users/Jin/Documents/GitHub/ese518_Cellular_test/zephyr/soc/nxp/mcx/Kconfig.defconfig"
osource "C:/Users/Jin/Documents/GitHub/ese518_Cellular_test/zephyr/soc/nxp/lpc/Kconfig.defconfig"
osource "C:/Users/Jin/Documents/GitHub/ese518_Cellular_test/zephyr/soc/nxp/layerscape/Kconfig.defconfig"
osource "C:/Users/Jin/Documents/GitHub/ese518_Cellular_test/zephyr/soc/nxp/kinetis/Kconfig.defconfig"
osource "C:/Users/Jin/Documents/GitHub/ese518_Cellular_test/zephyr/soc/nxp/imxrt/Kconfig.defconfig"
osource "C:/Users/Jin/Documents/GitHub/ese518_Cellular_test/zephyr/soc/nxp/imx/Kconfig.defconfig"
osource "C:/Users/Jin/Documents/GitHub/ese518_Cellular_test/zephyr/soc/nuvoton/numicro/Kconfig.defconfig"
osource "C:/Users/Jin/Documents/GitHub/ese518_Cellular_test/zephyr/soc/nuvoton/numaker/Kconfig.defconfig"
osource "C:/Users/Jin/Documents/GitHub/ese518_Cellular_test/zephyr/soc/nuvoton/npcx/Kconfig.defconfig"
osource "C:/Users/Jin/Documents/GitHub/ese518_Cellular_test/zephyr/soc/nordic/Kconfig.defconfig"
osource "C:/Users/Jin/Documents/GitHub/ese518_Cellular_test/zephyr/soc/neorv32/Kconfig.defconfig"
osource "C:/Users/Jin/Documents/GitHub/ese518_Cellular_test/zephyr/soc/native/inf_clock/Kconfig.defconfig"
osource "C:/Users/Jin/Documents/GitHub/ese518_Cellular_test/zephyr/soc/microchip/miv/Kconfig.defconfig"
osource "C:/Users/Jin/Documents/GitHub/ese518_Cellular_test/zephyr/soc/microchip/mec/Kconfig.defconfig"
osource "C:/Users/Jin/Documents/GitHub/ese518_Cellular_test/zephyr/soc/lowrisc/opentitan/Kconfig.defconfig"
osource "C:/Users/Jin/Documents/GitHub/ese518_Cellular_test/zephyr/soc/litex/litex_vexriscv/Kconfig.defconfig"
osource "C:/Users/Jin/Documents/GitHub/ese518_Cellular_test/zephyr/soc/ite/ec/Kconfig.defconfig"
osource "C:/Users/Jin/Documents/GitHub/ese518_Cellular_test/zephyr/soc/intel/raptor_lake/Kconfig.defconfig"
osource "C:/Users/Jin/Documents/GitHub/ese518_Cellular_test/zephyr/soc/intel/lakemont/Kconfig.defconfig"
osource "C:/Users/Jin/Documents/GitHub/ese518_Cellular_test/zephyr/soc/intel/intel_socfpga_std/Kconfig.defconfig"
osource "C:/Users/Jin/Documents/GitHub/ese518_Cellular_test/zephyr/soc/intel/intel_socfpga/Kconfig.defconfig"
osource "C:/Users/Jin/Documents/GitHub/ese518_Cellular_test/zephyr/soc/intel/intel_niosv/Kconfig.defconfig"
osource "C:/Users/Jin/Documents/GitHub/ese518_Cellular_test/zephyr/soc/intel/intel_ish/Kconfig.defconfig"
osource "C:/Users/Jin/Documents/GitHub/ese518_Cellular_test/zephyr/soc/intel/intel_adsp/Kconfig.defconfig"
osource "C:/Users/Jin/Documents/GitHub/ese518_Cellular_test/zephyr/soc/intel/elkhart_lake/Kconfig.defconfig"
osource "C:/Users/Jin/Documents/GitHub/ese518_Cellular_test/zephyr/soc/intel/atom/Kconfig.defconfig"
osource "C:/Users/Jin/Documents/GitHub/ese518_Cellular_test/zephyr/soc/intel/apollo_lake/Kconfig.defconfig"
osource "C:/Users/Jin/Documents/GitHub/ese518_Cellular_test/zephyr/soc/intel/alder_lake/Kconfig.defconfig"
osource "C:/Users/Jin/Documents/GitHub/ese518_Cellular_test/zephyr/soc/infineon/cat3/Kconfig.defconfig"
osource "C:/Users/Jin/Documents/GitHub/ese518_Cellular_test/zephyr/soc/infineon/cat1a/Kconfig.defconfig"
osource "C:/Users/Jin/Documents/GitHub/ese518_Cellular_test/zephyr/soc/gd/gd32/Kconfig.defconfig"
osource "C:/Users/Jin/Documents/GitHub/ese518_Cellular_test/zephyr/soc/gaisler/leon3/Kconfig.defconfig"
osource "C:/Users/Jin/Documents/GitHub/ese518_Cellular_test/zephyr/soc/gaisler/gr716a/Kconfig.defconfig"
osource "C:/Users/Jin/Documents/GitHub/ese518_Cellular_test/zephyr/soc/espressif/Kconfig.defconfig"
osource "C:/Users/Jin/Documents/GitHub/ese518_Cellular_test/zephyr/soc/ene/kb1200/Kconfig.defconfig"
osource "C:/Users/Jin/Documents/GitHub/ese518_Cellular_test/zephyr/soc/efinix/sapphire/Kconfig.defconfig"
osource "C:/Users/Jin/Documents/GitHub/ese518_Cellular_test/zephyr/soc/cdns/xtensa_sample_controller/Kconfig.defconfig"
osource "C:/Users/Jin/Documents/GitHub/ese518_Cellular_test/zephyr/soc/cdns/dc233c/Kconfig.defconfig"
osource "C:/Users/Jin/Documents/GitHub/ese518_Cellular_test/zephyr/soc/brcm/bcmvk/Kconfig.defconfig"
osource "C:/Users/Jin/Documents/GitHub/ese518_Cellular_test/zephyr/soc/brcm/bcm2712/Kconfig.defconfig"
osource "C:/Users/Jin/Documents/GitHub/ese518_Cellular_test/zephyr/soc/brcm/bcm2711/Kconfig.defconfig"
osource "C:/Users/Jin/Documents/GitHub/ese518_Cellular_test/zephyr/soc/atmel/sam0/Kconfig.defconfig"
osource "C:/Users/Jin/Documents/GitHub/ese518_Cellular_test/zephyr/soc/atmel/sam/Kconfig.defconfig"
osource "C:/Users/Jin/Documents/GitHub/ese518_Cellular_test/zephyr/soc/aspeed/Kconfig.defconfig"
osource "C:/Users/Jin/Documents/GitHub/ese518_Cellular_test/zephyr/soc/arm/Kconfig.defconfig"
osource "C:/Users/Jin/Documents/GitHub/ese518_Cellular_test/zephyr/soc/arm/beetle/Kconfig.defconfig"
osource "C:/Users/Jin/Documents/GitHub/ese518_Cellular_test/zephyr/soc/andestech/Kconfig.defconfig"
osource "C:/Users/Jin/Documents/GitHub/ese518_Cellular_test/zephyr/soc/ambiq/Kconfig.defconfig"
osource "C:/Users/Jin/Documents/GitHub/ese518_Cellular_test/zephyr/soc/altr/zephyr_nios2f/Kconfig.defconfig"
osource "C:/Users/Jin/Documents/GitHub/ese518_Cellular_test/zephyr/soc/altr/qemu_nios2/Kconfig.defconfig"
```

## build/mcuboot/Kconfig/Kconfig.shield.defconfig
```kconfig
osource "c:/users/jin/documents/github/ese518_cellular_test/boards/shields/*/Kconfig.defconfig"
osource "C:/Users/Jin/Documents/GitHub/ese518_Cellular_test/nrf/boards/shields/*/Kconfig.defconfig"
```

## build/mcuboot/Kconfig/arch/Kconfig
```kconfig
# Load arch Kconfig descriptions.
osource "C:/Users/Jin/Documents/GitHub/ese518_Cellular_test/zephyr/arch/x86/Kconfig"
osource "C:/Users/Jin/Documents/GitHub/ese518_Cellular_test/zephyr/arch/xtensa/Kconfig"
osource "C:/Users/Jin/Documents/GitHub/ese518_Cellular_test/zephyr/arch/sparc/Kconfig"
osource "C:/Users/Jin/Documents/GitHub/ese518_Cellular_test/zephyr/arch/riscv/Kconfig"
osource "C:/Users/Jin/Documents/GitHub/ese518_Cellular_test/zephyr/arch/posix/Kconfig"
osource "C:/Users/Jin/Documents/GitHub/ese518_Cellular_test/zephyr/arch/nios2/Kconfig"
osource "C:/Users/Jin/Documents/GitHub/ese518_Cellular_test/zephyr/arch/mips/Kconfig"
osource "C:/Users/Jin/Documents/GitHub/ese518_Cellular_test/zephyr/arch/arm64/Kconfig"
osource "C:/Users/Jin/Documents/GitHub/ese518_Cellular_test/zephyr/arch/arm/Kconfig"
osource "C:/Users/Jin/Documents/GitHub/ese518_Cellular_test/zephyr/arch/arc/Kconfig"
```
